## conf/layer.conf
```bitbake
# We have a conf and classes directory, add to BBPATH
BBPATH .= ":${LAYERDIR}"

# We have recipes-* directories, add to BBFILES
BBFILES += "${LAYERDIR}/recipes-*/*/*.bb \
            ${LAYERDIR}/recipes-*/*/*.bbappend"

BBFILE_COLLECTIONS += "meta-markyang-raspberrypi"
BBFILE_PATTERN_meta-markyang-raspberrypi = "^${LAYERDIR}/"
BBFILE_PRIORITY_meta-markyang-raspberrypi = "10"

LAYERDEPENDS_meta-markyang-raspberrypi = "core"
LAYERSERIES_COMPAT_meta-markyang-raspberrypi = "dunfell"
```

## conf/machine/raspberrypi4-64-custom.conf
```bitbake
require conf/machine/raspberrypi4-64-custom.inc

ENABLE_UART = "1"
UNABLE_I2C = "1"
ENABLE_SPI_BUS ="1"

KERNEL_MODULE_AUTOLOAD += "i2c-dev"
```
